## boards/arm/eyelash_sofle/eyelash_sofle_dongle_defconfig
```kconfig
CONFIG_ZMK_SPLIT=y
CONFIG_ZMK_SPLIT_BLE=y
CONFIG_ZMK_SPLIT_ROLE_CENTRAL=y

CONFIG_ZMK_USB=y            # USB HID am PC
CONFIG_ZMK_BLE=y
CONFIG_BT_MAX_CONN=2        # kann beide Sofle-Hälften verwalten
CONFIG_ZMK_BLE_CLEAR_BONDS_ON_START=y # startet frisch
```
