/ {
    kscan0: kscan0 {
        compatible = "zmk,keyboard-kscan";
        row-gpios = <&gpio0 2 GPIO_ACTIVE_LOW>,
                    <&gpio0 3 GPIO_ACTIVE_LOW>;
        col-gpios = <&gpio0 4 GPIO_ACTIVE_LOW>,
                    <&gpio0 5 GPIO_ACTIVE_LOW>;
    };
};

